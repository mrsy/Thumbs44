## boards/shields/thums44/Kconfig.defconfig
```kconfig
if SHIELD_THUMBS44_RIGHT

config ZMK_KEYBOARD_NAME
    default "thumbs44"

endif

if SHIELD_THUMBS44_LEFT || SHIELD_THUMBS44_RIGHT

config ZMK_SPLIT
    default y

endif
```

## boards/shields/thums44/Kconfig.shield
```kconfig
config SHIELD_THUMBS44_LEFT
    def_bool $(shields_list_contains,thumbs44_left)
config SHIELD_THUMBS44_RIGHT
    def_bool $(shields_list_contains,thumbs44_right)
```
